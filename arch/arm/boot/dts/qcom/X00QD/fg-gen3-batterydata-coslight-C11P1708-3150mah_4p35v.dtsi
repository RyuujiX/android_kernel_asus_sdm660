
qcom,3282423_asus_c11p1708_3150mah_averaged_masterslave_jan3rd2018 {
	qcom, = <24>;
	/* #3282423_Asus_C11P1708_3150mAh_averaged_MasterSlave_Jan3rd2018*/
	qcom,max-voltage-uv = <4357000>;
	qcom,nom-batt-capacity-mah = <3150>;
	qcom,batt-id-kohm = <51>;
	qcom,battery-beta = <3380>;
	qcom,battery-type = "3282423_asus_c11p1708_3150mah_averaged_masterslave_jan3rd2018";
	qcom,checksum = <0x57B9>;
	qcom,gui-version = "PM660GUI - 0.0.0.45";
	qcom,fg-profile-data = [
		 8F 1E C1 FD
		 C4 02 95 F5
		 CC 1C 31 02
		 39 0D 2E 0B
		 DB 17 6F 23
		 0D 45 7B 53
		 66 00 00 00
		 12 00 00 00
		 00 00 98 BD
		 B3 C4 D8 BB
		 20 00 08 00
		 82 DA CB E5
		 99 05 1B FB
		 0D 15 4D 01
		 4F ED 4E 32
		 24 06 09 20
		 27 00 14 00
		 8D 1F EA 05
		 14 0A BB 06
		 C5 1C E8 02
		 1B 0C 11 12
		 83 18 D5 23
		 E7 4D 2F 5B
		 6B 00 00 00
		 0E 00 00 00
		 00 00 B1 D5
		 10 CA 24 CA
		 19 00 00 00
		 2B E3 CB E5
		 87 FC 0B 01
		 E5 06 23 03
		 FF 06 91 1B
		 B3 33 CC FF
		 07 10 00 00
		 7A 0C B6 45
		 19 00 40 00
		 BA 01 0A FA
		 FF 00 00 00
		 00 00 00 00
		 00 00 00 00
		 00 00 00 00
		 00 00 00 00
		 00 00 00 00
		 00 00 00 00
		 00 00 00 00
		 00 00 00 00
		 00 00 00 00
		 00 00 00 00
		 00 00 00 00
		 00 00 00 00
		 00 00 00 00
		 00 00 00 00
		 00 00 00 00
		 00 00 00 00
		 00 00 00 00
		 00 00 00 00
	];
};
