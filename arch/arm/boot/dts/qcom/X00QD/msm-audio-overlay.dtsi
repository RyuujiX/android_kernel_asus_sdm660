/* SPDX-License-Identifier: GPL-2.0 */

&dai_mi2s2 {
	qcom,msm-mi2s-rx-lines = <1>;
	qcom,msm-mi2s-tx-lines = <2>;
};

&int_codec {
	/delete-property/ qcom,msm-micbias2-ext-cap;

	qcom,msm-micbias1-ext-cap;
	qcom,msm-hs-micbias-type = "external";
	qcom,wsa-disable;
	qcom,tert-mi2s-gpios = <&tert_mi2s_gpios>;
	qcom,audio-routing =
		"RX_BIAS", "INT_MCLK0",
		"SPK_RX_BIAS", "INT_MCLK0",
		"INT_LDO_H", "INT_MCLK0",
		"RX_I2S_CLK", "INT_MCLK0",
		"TX_I2S_CLK", "INT_MCLK0",
		"MIC BIAS Internal1", "Handset Mic",
		"MIC BIAS External2", "Headset Mic",
		"MIC BIAS Internal1", "Secondary Mic",
		"AMIC1", "MIC BIAS Internal1",
		"AMIC2", "MIC BIAS External2",
		"AMIC3", "MIC BIAS Internal1",
		"PDM_IN_RX1", "PDM_OUT_RX1",
		"PDM_IN_RX2", "PDM_OUT_RX2",
		"PDM_IN_RX3", "PDM_OUT_RX3",
		"ADC1_IN", "ADC1_OUT",
		"ADC2_IN", "ADC2_OUT",
		"ADC3_IN", "ADC3_OUT";
};
