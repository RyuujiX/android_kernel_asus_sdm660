/* Copyright (c) 2013-2015, The Linux Foundation. All rights reserved.
 *
 * This program is free software; you can redistribute it and/or modify
 * it under the terms of the GNU General Public License version 2 and
 * only version 2 as published by the Free Software Foundation.
 *
 * This program is distributed in the hope that it will be useful,
 * but WITHOUT ANY WARRANTY; without even the implied warranty of
 * MERCHANTABILITY or FITNESS FOR A PARTICULAR PURPOSE.  See the
 * GNU General Public License for more details.
 */

/*---------------------------------------------------------------------------
 * This file is autogenerated file using gcdb parser. Please do not edit it.
 * Update input XML file to add a new entry or update variable in this file
 * VERSION = "1.0"
 *---------------------------------------------------------------------------*/
&mdss_mdp {
	dsi_nt36672_1080p_video: qcom,mdss_dsi_nt36672_1080p_video {
		qcom,mdss-dsi-panel-name = "nt36672 1080p video mode dsi panel";
		qcom,mdss-dsi-panel-controller = <&mdss_dsi0>;
		qcom,mdss-dsi-panel-type = "dsi_video_mode";
		qcom,mdss-dsi-panel-destination = "display_1";
		qcom,mdss-dsi-panel-framerate = <60>;
		qcom,mdss-dsi-virtual-channel-id = <0>;
		qcom,mdss-dsi-stream = <0>;
		qcom,mdss-dsi-panel-width = <1080>;
		qcom,mdss-dsi-panel-height = <2160>;
		qcom,mdss-dsi-h-front-porch = <72>;
		qcom,mdss-dsi-h-back-porch = <84>;
		qcom,mdss-dsi-h-pulse-width = <4>;
		qcom,mdss-dsi-h-sync-skew = <0>;
		qcom,mdss-dsi-v-back-porch = <14>;
		qcom,mdss-dsi-v-front-porch = <12>;
		qcom,mdss-dsi-v-pulse-width = <2>;
		qcom,mdss-dsi-h-left-border = <0>;
		qcom,mdss-dsi-h-right-border = <0>;
		qcom,mdss-dsi-v-top-border = <0>;
		qcom,mdss-dsi-v-bottom-border = <0>;
		qcom,mdss-dsi-bpp = <24>;
		qcom,mdss-dsi-color-order = "rgb_swap_rgb";
		qcom,mdss-dsi-underflow-color = <0xff>;
		qcom,mdss-dsi-border-color = <0>;
		//qcom,mdss-dsi-on-command = [//29 01 00 00 00 00 02 FF E0
			//29 01 00 00 00 00 02 FB 01
			//29 01 00 00 00 00 02 73 20
		qcom,mdss-dsi-on-command = [
			//ESD_1128_BEGIN
			//29 01 00 00 00 00 02 FF 10
			//29 01 00 00 00 00 02 F5 F5
			//ESD_1128_END
			29 01 00 00 00 00 02 FF 20
			29 01 00 00 00 00 02 FB 01
			29 01 00 00 00 00 02 58 03
			29 01 00 00 00 00 02 57 01
			29 01 00 00 00 00 02 FF 24
			29 01 00 00 00 00 02 FB 01
			29 01 00 00 00 00 02 B7 80
			29 01 00 00 00 00 02 C4 84
			29 01 00 00 00 00 02 FF 20
			29 01 00 00 00 00 02 FB 01
			29 01 00 00 00 00 02 30 10
			29 01 00 00 00 00 02 31 50
			29 01 00 00 00 00 02 32 2F
			29 01 00 00 00 00 02 01 33
			29 01 00 00 00 00 02 06 99
			29 01 00 00 00 00 02 07 9E
			29 01 00 00 00 00 02 0E 30
			29 01 00 00 00 00 02 0F 2E
			29 01 00 00 00 00 02 1D 33
			29 01 00 00 00 00 02 6D 66
			29 01 00 00 00 00 02 68 03
			29 01 00 00 00 00 02 69 99
			//29 01 00 00 00 00 02 89 0C
			29 01 00 00 00 00 02 95 CD
			29 01 00 00 00 00 02 96 CD
			29 01 00 00 00 00 02 FF 24
			29 01 00 00 00 00 02 FB 01
			29 01 00 00 00 00 02 00 01
			29 01 00 00 00 00 02 01 1C
			29 01 00 00 00 00 02 02 0B
			29 01 00 00 00 00 02 03 0C
			29 01 00 00 00 00 02 04 29
			29 01 00 00 00 00 02 05 0F
			29 01 00 00 00 00 02 06 0F
			29 01 00 00 00 00 02 07 03
			29 01 00 00 00 00 02 08 05
			29 01 00 00 00 00 02 09 22
			29 01 00 00 00 00 02 0A 00
			29 01 00 00 00 00 02 0B 24
			29 01 00 00 00 00 02 0C 13
			29 01 00 00 00 00 02 0D 13
			29 01 00 00 00 00 02 0E 15
			29 01 00 00 00 00 02 0F 15
			29 01 00 00 00 00 02 10 17
			29 01 00 00 00 00 02 11 17
			29 01 00 00 00 00 02 12 01
			29 01 00 00 00 00 02 13 1C
			29 01 00 00 00 00 02 14 0B
			29 01 00 00 00 00 02 15 0C
			29 01 00 00 00 00 02 16 29
			29 01 00 00 00 00 02 17 0F
			29 01 00 00 00 00 02 18 0F
			29 01 00 00 00 00 02 19 04
			29 01 00 00 00 00 02 1A 06
			29 01 00 00 00 00 02 1B 23
			29 01 00 00 00 00 02 1C 0F
			29 01 00 00 00 00 02 1D 24
			29 01 00 00 00 00 02 1E 13
			29 01 00 00 00 00 02 1F 13
			29 01 00 00 00 00 02 20 15
			29 01 00 00 00 00 02 21 15
			29 01 00 00 00 00 02 22 17
			29 01 00 00 00 00 02 23 17
			29 01 00 00 00 00 02 2F 04
			29 01 00 00 00 00 02 30 08
			29 01 00 00 00 00 02 31 04
			29 01 00 00 00 00 02 32 08
			29 01 00 00 00 00 02 33 04
			29 01 00 00 00 00 02 34 04
			29 01 00 00 00 00 02 35 00
			29 01 00 00 00 00 02 37 09
			29 01 00 00 00 00 02 38 75
			29 01 00 00 00 00 02 39 75
			29 01 00 00 00 00 02 3B C0
			29 01 00 00 00 00 02 3F 75
			29 01 00 00 00 00 02 60 10
			29 01 00 00 00 00 02 61 00
			29 01 00 00 00 00 02 68 C2
			29 01 00 00 00 00 02 78 80
			29 01 00 00 00 00 02 79 23
			29 01 00 00 00 00 02 7A 10
			29 01 00 00 00 00 02 7B 9B
			29 01 00 00 00 00 02 7C 80
			29 01 00 00 00 00 02 7D 06
			29 01 00 00 00 00 02 7E 02
			29 01 00 00 00 00 02 8E F0
			29 01 00 00 00 00 02 92 76
			29 01 00 00 00 00 02 93 0A
			29 01 00 00 00 00 02 94 0A
			29 01 00 00 00 00 02 99 33
			29 01 00 00 00 00 02 9B FF
			29 01 00 00 00 00 02 9F 00
			29 01 00 00 00 00 02 A3 91
			29 01 00 00 00 00 02 B3 00
			29 01 00 00 00 00 02 B4 00
			29 01 00 00 00 00 02 B5 04
			29 01 00 00 00 00 02 DC 40
			29 01 00 00 00 00 02 DD 03
			29 01 00 00 00 00 02 DE 01
			29 01 00 00 00 00 02 DF 3D
			29 01 00 00 00 00 02 E0 3D
			29 01 00 00 00 00 02 E1 22
			29 01 00 00 00 00 02 E2 24
			29 01 00 00 00 00 02 E3 0A
			29 01 00 00 00 00 02 E4 0A
			29 01 00 00 00 00 02 E8 01
			29 01 00 00 00 00 02 E9 10
			29 01 00 00 00 00 02 ED 40
			29 01 00 00 00 00 02 FF 25
			29 01 00 00 00 00 02 FB 01
			29 01 00 00 00 00 02 0A 81
			29 01 00 00 00 00 02 0B CD
			29 01 00 00 00 00 02 0C 01
			29 01 00 00 00 00 02 17 82
			29 01 00 00 00 00 02 21 1B
			29 01 00 00 00 00 02 22 1B
			29 01 00 00 00 00 02 24 76
			29 01 00 00 00 00 02 25 76
			29 01 00 00 00 00 02 30 2A
			29 01 00 00 00 00 02 31 2A
			29 01 00 00 00 00 02 38 2A
			29 01 00 00 00 00 02 3F 11
			29 01 00 00 00 00 02 40 3A
			29 01 00 00 00 00 02 4B 31
			29 01 00 00 00 00 02 4C 3A
			29 01 00 00 00 00 02 58 22
			29 01 00 00 00 00 02 59 05
			29 01 00 00 00 00 02 5A 0A
			29 01 00 00 00 00 02 5B 0A
			29 01 00 00 00 00 02 5C 25
			29 01 00 00 00 00 02 5D 80
			29 01 00 00 00 00 02 5E 80
			29 01 00 00 00 00 02 5F 28
			29 01 00 00 00 00 02 62 3F
			29 01 00 00 00 00 02 63 82
			29 01 00 00 00 00 02 65 00
			29 01 00 00 00 00 02 66 DD
			29 01 00 00 00 00 02 6C 6D
			29 01 00 00 00 00 02 71 6D
			29 01 00 00 00 00 02 78 25
			29 01 00 00 00 00 02 C3 00
			29 01 00 00 00 00 02 FF 26
			29 01 00 00 00 00 02 FB 01
			29 01 00 00 00 00 02 06 C8
			29 01 00 00 00 00 02 12 5A
			29 01 00 00 00 00 02 19 09
			29 01 00 00 00 00 02 1A 84
			29 01 00 00 00 00 02 1C FA
			29 01 00 00 00 00 02 1D 09
			29 01 00 00 00 00 02 1E 0B
			29 01 00 00 00 00 02 99 20
			29 01 00 00 00 00 02 FF 27
			29 01 00 00 00 00 02 FB 01
			29 01 00 00 00 00 02 13 08
			29 01 00 00 00 00 02 14 43
			29 01 00 00 00 00 02 16 B8
			29 01 00 00 00 00 02 17 B8
			29 01 00 00 00 00 02 7A 02
			29 01 00 00 00 00 02 FF 20
			29 01 00 00 00 00 02 FB 01
			29 01 00 00 00 00 11 B0 00 00 00 30 00 69 00 92 00 B1 00 CA 00 E1 00 F4
			29 01 00 00 00 00 11 B1 01 05 01 3D 01 63 01 A0 01 C9 02 08 02 34 02 36
			29 01 00 00 00 00 11 B2 02 61 02 94 02 BC 02 EF 03 07 03 40 03 4C 03 5B
			29 01 00 00 00 00 0D B3 03 6B 03 7F 03 95 03 B5 03 D2 03 D7
			29 01 00 00 00 00 11 B4 00 00 00 30 00 69 00 92 00 B1 00 CA 00 E1 00 F4
			29 01 00 00 00 00 11 B5 01 05 01 3D 01 63 01 A0 01 C9 02 08 02 34 02 36
			29 01 00 00 00 00 11 B6 02 61 02 94 02 BC 02 EF 03 07 03 40 03 4C 03 5B
			29 01 00 00 00 00 0D B7 03 6B 03 7F 03 95 03 B5 03 D2 03 D7
			29 01 00 00 00 00 11 B8 00 00 00 30 00 69 00 92 00 B1 00 CA 00 E1 00 F4
			29 01 00 00 00 00 11 B9 01 05 01 3D 01 63 01 A0 01 C9 02 08 02 34 02 36
			29 01 00 00 00 00 11 BA 02 61 02 94 02 BC 02 EF 03 07 03 40 03 4C 03 5B
			29 01 00 00 00 00 0D BB 03 6B 03 7F 03 95 03 B5 03 D2 03 D7
			29 01 00 00 00 00 02 FF 21
			29 01 00 00 00 00 02 FB 01
			29 01 00 00 00 00 11 B0 00 00 00 30 00 69 00 92 00 B1 00 CA 00 E1 00 F4
			29 01 00 00 00 00 11 B1 01 05 01 3D 01 63 01 A0 01 C9 02 08 02 34 02 36
			29 01 00 00 00 00 11 B2 02 61 02 94 02 BC 02 EF 03 07 03 40 03 4C 03 5B
			29 01 00 00 00 00 0D B3 03 6B 03 7F 03 95 03 B5 03 D2 03 D7
			29 01 00 00 00 00 11 B4 00 00 00 30 00 69 00 92 00 B1 00 CA 00 E1 00 F4
			29 01 00 00 00 00 11 B5 01 05 01 3D 01 63 01 A0 01 C9 02 08 02 34 02 36
			29 01 00 00 00 00 11 B6 02 61 02 94 02 BC 02 EF 03 07 03 40 03 4C 03 5B
			29 01 00 00 00 00 0D B7 03 6B 03 7F 03 95 03 B5 03 D2 03 D7
			29 01 00 00 00 00 11 B8 00 00 00 30 00 69 00 92 00 B1 00 CA 00 E1 00 F4
			29 01 00 00 00 00 11 B9 01 05 01 3D 01 63 01 A0 01 C9 02 08 02 34 02 36
			29 01 00 00 00 00 11 BA 02 61 02 94 02 BC 02 EF 03 07 03 40 03 4C 03 5B
			29 01 00 00 00 00 0D BB 03 6B 03 7F 03 95 03 B5 03 D2 03 D7
			//GAMMA & CABC 20180125 Start
			29 01 00 00 00 00 02 FF 23
			29 01 00 00 00 00 02 FB 01
			29 01 00 00 00 00 02 07 20
			29 01 00 00 00 00 02 08 53
			29 01 00 00 00 00 02 09 00
			29 01 00 00 00 00 02 11 03
			29 01 00 00 00 00 02 12 ff
			29 01 00 00 00 00 02 15 ff
			29 01 00 00 00 00 02 16 0c
			29 01 00 00 00 00 02 19 ff
			29 01 00 00 00 00 02 1a ff
			29 01 00 00 00 00 02 1b ff
			29 01 00 00 00 00 02 1c ff
			29 01 00 00 00 00 02 1d ff
			29 01 00 00 00 00 02 1e ff
			29 01 00 00 00 00 02 1f ff
			29 01 00 00 00 00 02 20 ff
			29 01 00 00 00 00 02 21 ff
			29 01 00 00 00 00 02 22 ff
			29 01 00 00 00 00 02 23 ff
			29 01 00 00 00 00 02 24 ff
			29 01 00 00 00 00 02 25 ff
			29 01 00 00 00 00 02 26 ff
			29 01 00 00 00 00 02 27 ff
			29 01 00 00 00 00 02 28 ff
			29 01 00 00 00 00 02 45 ff
			29 01 00 00 00 00 02 46 f9
			29 01 00 00 00 00 02 47 f7
			29 01 00 00 00 00 02 48 f6
			29 01 00 00 00 00 02 49 f6
			29 01 00 00 00 00 02 4A f2
			29 01 00 00 00 00 02 4B e6
			29 01 00 00 00 00 02 4C d2
			29 01 00 00 00 00 02 4D bc
			29 01 00 00 00 00 02 4E cb
			29 01 00 00 00 00 02 4F aa
			29 01 00 00 00 00 02 50 9e
			29 01 00 00 00 00 02 51 97
			29 01 00 00 00 00 02 52 96
			29 01 00 00 00 00 02 53 95
			29 01 00 00 00 00 02 54 94
			//GAMMA & CABC 20180125 end
			29 01 00 00 00 00 02 FF 10
			29 01 00 00 00 00 02 FB 01
			29 01 00 00 00 00 02 51 e6
			29 01 00 00 00 00 02 53 2c
			29 01 00 00 00 00 02 55 02
			//29 01 00 00 00 00 02 36 03
			05 01 00 00 64 00 02 11 00
			05 01 00 00 14 00 02 29 00];
			//29 01 00 00 00 00 02 f0 55
			//29 01 00 00 00 00 02 f1 aa
			//29 01 00 00 00 00 02 f2 66
			//29 01 00 00 00 00 02 FF 20
			//29 01 00 00 00 00 02 FB 01
			//29 01 00 00 00 00 02 58 03
			//29 01 00 00 00 00 02 57 01
			//29 01 00 00 00 00 02 FF 10];
		qcom,mdss-dsi-on-command1 = [
			29 01 00 00 01 00 02 FF E0
			29 01 00 00 0A 00 02 55 2F
			29 01 00 00 16 00 02 55 0F];
		qcom,mdss-dsi-off-command = [
			//29 01 00 00 00 00 02 f0 aa
			//29 01 00 00 00 00 02 f1 55
			//29 01 00 00 00 00 02 f2 99
			29 01 00 00 00 00 02 FF 10
			05 01 00 00 00 00 02 28 00
			05 01 00 00 3C 00 02 10 00
			29 01 00 00 0A 00 02 4F 01];
		qcom,mdss-dsi-on-command-state = "dsi_lp_mode";
		qcom,mdss-dsi-on-command1-state = "dsi_lp_mode";
		qcom,mdss-dsi-off-command-state = "dsi_lp_mode";
		qcom,mdss-dsi-h-sync-pulse = <1>;
		qcom,mdss-dsi-traffic-mode = "burst_mode";
		qcom,mdss-dsi-lane-map = "lane_map_0123";
		qcom,mdss-dsi-bllp-eof-power-mode;
		qcom,mdss-dsi-bllp-power-mode;
		qcom,mdss-dsi-lp11-init;
		qcom,mdss-dsi-init-delay-us = <50000>;
		qcom,mdss-dsi-lane-0-state;
		qcom,mdss-dsi-lane-1-state;
		qcom,mdss-dsi-lane-2-state;
		qcom,mdss-dsi-lane-3-state;
		qcom,mdss-dsi-panel-timings = [FE 3C 2A 00 70 74 2E 40 30 03 04 00];
		qcom,mdss-dsi-panel-timings-phy-v2 = [25 22 09 08 06 03 04 a0
			25 22 09 08 06 03 04 a0
			25 22 09 08 06 03 04 a0
			25 22 09 08 06 03 04 a0
			25 21 08 08 06 03 04 a0];
		qcom,mdss-dsi-min-refresh-rate = <60>;
		qcom,mdss-dsi-max-refresh-rate = <60>;
		qcom,mdss-dsi-t-clk-post = <0x0E>;
		qcom,mdss-dsi-t-clk-pre = <0x33>;
		qcom,mdss-dsi-bl-min-level = <1>;
		qcom,mdss-dsi-bl-max-level = <4095>;
		qcom,mdss-dsi-dma-trigger = "trigger_sw";
		qcom,mdss-dsi-mdp-trigger = "none";
		qcom,mdss-dsi-bl-pmic-control-type = "bl_ctrl_wled";
		//qcom,mdss-dsi-bl-pmic-control-type = "bl_ctrl_dcs";
		qcom,mdss-pan-physical-width-dimension = <68>;
		qcom,mdss-pan-physical-height-dimension = <136>;
		qcom,mdss-dsi-reset-sequence = <1 10>, <0 5>, <1 5>, <0 5>, <1 10>;
		qcom,esd-check-enabled;
		qcom,mdss-dsi-panel-status-command = [06 01 00 01 05 00 02 0a 00];
							//06 01 00 01 05 00 02 ab 00];
		qcom,mdss-dsi-panel-status-command-state = "dsi_hs_mode";
		qcom,mdss-dsi-panel-status-check-mode = "reg_read";
		qcom,mdss-dsi-panel-status-read-length = <1>;
		qcom,mdss-dsi-panel-status-valid-params = <1>;
		qcom,mdss-dsi-panel-status-value = <0x9c>;
		qcom,mdss-dsi-tx-eot-append;
		qcom,mdss-dsi-panel-max-error-count = <20>;
		qcom,panel-supply-entries = <&dsi_panel_pwr_supply>;
	};
};
